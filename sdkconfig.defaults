## sdkconfig.defaults
```kconfig
# =================  LVGL & 分区配置 (保留) =================
CONFIG_LV_COLOR_16_SWAP=y
CONFIG_LV_COLOR_DEPTH_16=y
CONFIG_LV_USE_USER_DATA=y
CONFIG_LV_FONT_MONTSERRAT_20=y
CONFIG_LV_FONT_SIMSUN_16_CJK=y
CONFIG_PARTITION_TABLE_SINGLE_APP_LARGE=y
# CONFIG_LV_BUILD_EXAMPLES is not set

# ================= 硬件基础配置 =================
CONFIG_ESPTOOLPY_FLASHSIZE_16MB=y
CONFIG_ESPTOOLPY_FLASHMODE_QIO=y
CONFIG_ESP_DEFAULT_CPU_FREQ_MHZ_240=y
CONFIG_ESP_DEFAULT_CPU_FREQ_MHZ=240
CONFIG_ESP_SYSTEM_EVENT_TASK_STACK_SIZE=6144

# ================= PSRAM 配置 (防 Netif 死锁) =================
CONFIG_SPIRAM=y
CONFIG_SPIRAM_MODE_OCT=y
CONFIG_SPIRAM_SPEED_40M=y
CONFIG_SPIRAM_MALLOC_ALWAYSINTERNAL=16384
CONFIG_SPIRAM_MALLOC_RESERVE_INTERNAL=98304
CONFIG_SPIRAM_MEMTEST=n

# ================= 看门狗 & 系统容错 =================
CONFIG_ESP_INT_WDT_TIMEOUT_MS=500
CONFIG_ESP_TASK_WDT_TIMEOUT_S=10

# ================= WiFi & LWIP 优化 =================
CONFIG_ESP_WIFI_STATIC_RX_BUFFER_NUM=3
CONFIG_ESP_WIFI_DYNAMIC_RX_BUFFER_NUM=6
CONFIG_ESP_WIFI_RX_BA_WIN=3
CONFIG_LWIP_TCPIP_RECVMBOX_SIZE=16
CONFIG_MBEDTLS_EXTERNAL_MEM_ALLOC=y
```
